MEMORY
{
  FLASH : ORIGIN = 0x08000000, LENGTH = 128K
  RAM   : ORIGIN = 0x20000000, LENGTH = 8K
}

PROVIDE(__tim7 = __default_handler);

__GPIOA = 0x40010800;
__GPIOC = 0x40011000;
__RCC = 0x40021000;
__TIM7 = 0x40001400;

__ITM = 0xE0000000;
__NVIC = 0xE000E100;

__BITBAND_START = 0x40000000;
__BITBAND_ALIAS = 0x42000000;

__BB_GPIOA = __BITBAND_ALIAS + 32 * (__GPIOA - __BITBAND_START);
__BB_GPIOC = __BITBAND_ALIAS + 32 * (__GPIOC - __BITBAND_START);
__BB_RCC = __BITBAND_ALIAS + 32 * (__RCC - __BITBAND_START);
__BB_TIM7 = __BITBAND_ALIAS + 32 * (__TIM7 - __BITBAND_START);

INCLUDE common.ld
INCLUDE cortex-m3.ld
